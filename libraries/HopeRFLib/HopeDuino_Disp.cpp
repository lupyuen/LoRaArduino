/*
 * THE FOLLOWING FIRMWARE IS PROVIDED: 
 *  (1) "AS IS" WITH NO WARRANTY; 
 *  (2) TO ENABLE ACCESS TO CODING INFORMATION TO GUIDE AND FACILITATE CUSTOMER.
 * CONSEQUENTLY, HopeRF SHALL NOT BE HELD LIABLE FOR ANY DIRECT, INDIRECT OR
 * CONSEQUENTIAL DAMAGES WITH RESPECT TO ANY CLAIMS ARISING FROM THE CONTENT
 * OF SUCH FIRMWARE AND/OR THE USE MADE BY CUSTOMERS OF THE CODING INFORMATION
 * CONTAINED HEREIN IN CONNECTION WITH THEIR PRODUCTS.
 * 
 * Copyright (C) HopeRF
 *
 * website: www.HopeRF.com
 *          www.HopeRF.cn 
 */

/*! 
 * file       HopeDuino_Disp.cpp
 * brief      
 * hardware   HopeRF's EVB & LcdShiled 
 *            
 *
 * version    1.0
 * date       Feb 15 2016
 * author     QY Ruan
 */
 
#include "HopeDuino_Disp.h"


static const byte logo_grap[512] =  { 
0XFF,0XFF,0XFF,0X7F,0X7F,0X7F,0X7F,0X7F,0XFF,0XFF,0XFF,0XFF,0XFF,0XFF,0XFF,0XFF,
0XFF,0X7F,0X7F,0X7F,0X7F,0XFF,0XFF,0XFF,0XFF,0XFF,0X7F,0X7F,0X7F,0X7F,0X7F,0X7F,
0X7F,0X7F,0X7F,0X7F,0X7F,0X7F,0X7F,0X7F,0XFF,0XFF,0XFF,0XFF,0XFF,0X7F,0X7F,0X7F,
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0X03,0X03,0X03,0X03,0X03,0X03,0X03,0X03,0X03,0X03,0X03,0X03,0X03,0X03,0X03,0X03,
};

static const byte Image_grap[1024] = { 
0XFF,0XFF,0XFF,0XFF,0XFF,0XFF,0XFF,0XFF,0XFF,0XFF,0XFF,0XFF,0XFF,0XFF,0XFF,0XFF,
0XFF,0XFF,0XFF,0XFF,0XFF,0XFF,0XFF,0XFF,0XFF,0XFF,0XFF,0XFF,0XFF,0XFF,0XFF,0XFF,
0X7F,0X7F,0X3F,0X3F,0X1F,0X1F,0X1F,0X1F,0X1F,0X1F,0X1F,0X1F,0X1F,0X1F,0X1F,0X1F,
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0XFF,0XFF,0XFF,0XFF,0XFF,0XFF,0XFF,0XFF,0XFF,0XFF,0XFF,0XFF,0XFF,0XFF,0XFF,0X7F,
};


void dispClass::vDispInit(void)
{
 JLX12864.vLcdInit();
}

void dispClass::vDispOn(void)
{
 JLX12864.vLcdEnable();
}

void dispClass::vDispOff(void)
{
 JLX12864.vLcdDisable();
}

void dispClass::vDispLight(bool on)
{
 JLX12864.vLcdLight(on);
}

void dispClass::vDispFull(void)
{
 JLX12864.vLcdFullDisplay();
}

void dispClass::vDispClear(void)
{
 JLX12864.vLcdClearScreen();
}

/**********************************************************
**Name:     vDisArduinoLogo
**Function: Show Arduino Logo
**Input:    positive for show positive or inverse
**Output:   none
**********************************************************/
void dispClass::vDisArduinoLogo(bool positive)
{
	byte i, j;
	for(i=1; i<9; i++)
		{
		JLX12864.vLcdLocate(i, 1);
		for(j=0;j<128;j++)
 			{
 			if(positive)
 				JLX12864.vSendData(Image_grap[(((word)(i-1))<<7)+j]^0xFF);	
 			else	
 				JLX12864.vSendData(Image_grap[(((word)(i-1))<<7)+j]);
 			}
		SetLCS();
		}
}

/**********************************************************
**Name:     vDisHopeRFLogo
**Function: Show HopeRF Logo
**Input:    line for start address(1-8), 
            positive for show positive or inverse
**Output:   none
**********************************************************/
void dispClass::vDisHopeRFLogo(byte line, bool positive)
{
	byte i, j;
	if((line==0)||(line>=9))
		line = 1;
	for(i=line; i<(line+4); i++)
		{
		JLX12864.vLcdLocate(i, 1);
		for(j=0;j<128;j++)
 			{
 			if(positive)
 				JLX12864.vSendData(logo_grap[(((word)(i-line))<<7)+j]^0xFF);	
 			else	
 				JLX12864.vSendData(logo_grap[(((word)(i-line))<<7)+j]);
 			}
		SetLCS();
		}
}	
	
/**********************************************************
**Name:     vDispGrap32x32
**Function: Show 32*32 grap.
**Input:    page, column, ptr
**Output:   none
**********************************************************/
void dispClass::vDispGrap32x32(byte page, byte column, byte ptr[])		
{
	byte j;
	for(j=0; j<4; j++)
		{
		JLX12864.vLcdLocate(page+j, column);
		JLX12864.vBurstSendData(ptr, 32);
		}
}

/**********************************************************
**Name:     vDispGrap16x16
**Function: Show 16*16 grap.
**Input:    page, column, ptr
**Output:   none
**********************************************************/
void dispClass::vDispGrap16x16(byte page, byte column, byte ptr[])		
{
	byte j;
	for(j=0; j<2; j++)
		{
		JLX12864.vLcdLocate(page+j, column);
		JLX12864.vBurstSendData(ptr, 16);
		}

}

/**********************************************************
**Name:     vDispGrap8x16
**Function: Show 8*16 grap.
**Input:    page, column, ptr
**Output:   none
**********************************************************/
void dispClass::vDispGrap8x16(byte page, byte column, byte ptr[])		
{
	byte j;
	for(j=0; j<2; j++)
		{
		JLX12864.vLcdLocate(page+j, column);
		JLX12864.vBurstSendData(ptr, 8);
		}
}

/**********************************************************
**Name:     vDispGrap8x8
**Function: Show 8*8 grap.
**Input:    page, column, ptr
**Output:   none
**********************************************************/
void dispClass::vDispGrap8x8(byte page, byte column, byte ptr[])		
{
 	JLX12864.vLcdLocate(page, column);
	JLX12864.vBurstSendData(ptr, 8);
}

/**********************************************************
**Name:     vDispString8x8
**Function: Show 8*8 grap.
**Input:    page, column, text for string
**Output:   none
**********************************************************/
void dispClass::vDispString8x8(byte page, byte column, byte text[]) 
{ 
 	byte i;
 	byte sptr[8];
 	i = 0;
 	
 	while(text[i]!='\0')				//不等于字符串结尾
 		{
 		JLX12864.vGetASCII8x8(text[i], sptr);
 		vDispGrap8x8(page, column, sptr);
 		i++;
 		column += 8;
 		}
} 	

/**********************************************************
**Name:     vDispSetDot
**Function: 
**Input:    
**Output:   none
**********************************************************/
void dispClass::vDispSetDot(byte x_axis, byte y_axis)
{
 byte i, j;
 i = y_axis&0x07;
 for(j=0x01;i!=0;i--)
 	j <<= 1;
 i = (y_axis>>3)+1;
 JLX12864.vLcdLocate(i, x_axis);
 JLX12864.vSendData(j);
 SetLCS();	
}

void dispClass::vDispFillDot(byte x_axis, byte y_axis)
{
 byte i, j, z;
 i = y_axis&0x07;
 switch(i)
 	{
 	case 1: j = 0xFE; break;
 	case 2: j = 0xFC; break;
 	case 3: j = 0xF8; break;			
 	case 4: j = 0xF0; break;
 	case 5: j = 0xE0; break;
 	case 6: j = 0xC0; break;
 	case 7: j = 0x80; break;	
 	case 0:
 	default:j = 0x00; break;
 	}
 i = (y_axis>>3)+1;	
 JLX12864.vLcdLocate(i, x_axis);
 JLX12864.vSendData(j);
 SetLCS();	
 i++;
 for( ; i<9; i++)
 	{
 	JLX12864.vLcdLocate(i, x_axis);
 	JLX12864.vSendData(0xFF);
 	SetLCS();	
 	}
}

/**********************************************************
**Name:     vDispClrYaxis
**Function: 
**Input:    
**Output:   none
**********************************************************/
void dispClass::vDispClrYaxis(byte x_axis)
{
 byte i;
 for(i=1; i<9; i++)
 	{	
 	JLX12864.vLcdLocate(i, x_axis);
 	JLX12864.vSendData(0);
 	SetLCS();	
	}
}
	


